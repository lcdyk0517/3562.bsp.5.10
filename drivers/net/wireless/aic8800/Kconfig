## drivers/net/wireless/aic8800/Kconfig
```kconfig
config AIC8800_USB
	tristate "AIC8800DC USB WiFi support (XF55H/NGP45HT)"
	depends on USB && CFG80211
	select WIRELESS_EXT
	select WEXT_PRIV
	help
	  AICsemi AIC8800DC USB WiFi driver (RAM-firmware loader aic_load_fw_usb
	  + WLAN driver aic8800_fdrv_usb). Built from in-tree sources (from
	  AveyondFly/aic8800-usb). Used by the Xifan XF55H / NGP45HT handhelds
	  whose WiFi hangs on the USB2 host bus.


config AIC_WLAN_SUPPORT
	tristate "AIC wireless Support"
	select WIRELESS_EXT
	select WEXT_PRIV
	select CFG80211
	select MAC80211
	select NL80211_TESTMODE
	help
	  This is support for aic wireless chip.

config AIC_FW_PATH
	depends on AIC_WLAN_SUPPORT
	string "Firmware & config file path"
	default "/usr/lib/kernel-overlays/base/lib/firmware"
	#default "/lib/firmware/aic8800_sdio"
	help
	  Path to the firmware & config file.

if AIC_WLAN_SUPPORT
source "drivers/net/wireless/aic8800/aic8800_fdrv/Kconfig"
source "drivers/net/wireless/aic8800/aic8800_btlpm/Kconfig"
endif
```

## drivers/net/wireless/zt9101/Kconfig
```kconfig
# SPDX-License-Identifier: GPL-2.0-only
config ZT9101_USB
	tristate "ZTop ZT9101 USB WiFi support"
	depends on USB && CFG80211
	help
	  Driver for the ZTop ZT9101 USB WiFi adapter used on the Xifan
	  XF55H handheld. Firmware and the vendor cfg file are read from
	  /lib/firmware/zt9101 (path set via modprobe.d).

	  Say M to build it as a module.
```
